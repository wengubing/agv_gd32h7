
#include "includes.h"
#include "..\..\Drivers\inc\drv_Common.h"


const u16 crc_ta[256] = { /* CRC余式表 */
	0x0000, 0x1021, 0x2042, 0x3063, 0x4084, 0x50a5, 0x60c6, 0x70e7,
	0x8108, 0x9129, 0xa14a, 0xb16b, 0xc18c, 0xd1ad, 0xe1ce, 0xf1ef,
	0x1231, 0x0210, 0x3273, 0x2252, 0x52b5, 0x4294, 0x72f7, 0x62d6,
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	0x6e17, 0x7e36, 0x4e55, 0x5e74, 0x2e93, 0x3eb2, 0x0ed1, 0x1ef0
};

u16 crc16(u8 *ptr, u16 len) 
{
	u16 crc;
	u8 da;
	crc = 0;
	while(len-- != 0) 
	{
		da = (u8)(crc >> 8);		//以8位二进制数的形式暂存CRC的高8位
		crc <<= 8;					//左移8位，相当于CRC的低8位乘以
		crc ^= crc_ta[da^*ptr];		//高8位和当前字节相加后再查表求CRC ，再加上以前的CRC
		ptr++;
	}
	return(crc);
}

// SEGD的表格 
const u8 segd_tab [16] = {			
0x3F, 0x06, 0x5B, 0x4F, 0x66, 0x6D, 0x7D, 0x27,
0x7F, 0x6F, 0x77, 0x7C, 0x39, 0x5E, 0x79, 0x71};

// 十六进制数对应的ascii码表
const u8 ascii_tab[16] = {
0x30, 0x31, 0x32, 0x33, 0x34, 0x35, 0x36, 0x37,
0x38, 0x39, 0x41, 0x42, 0x43, 0x44, 0x45, 0x46};				
										  
/* CRC16 高位字节值表 */
const u8 auchCRCHi[] = {
0x00, 0xC1, 0x81, 0x40, 0x01, 0xC0, 0x80, 0x41, 0x01, 0xC0,
0x80, 0x41, 0x00, 0xC1, 0x81, 0x40, 0x01, 0xC0, 0x80, 0x41,
0x00, 0xC1, 0x81, 0x40, 0x00, 0xC1, 0x81, 0x40, 0x01, 0xC0,
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0x80, 0x41, 0x00, 0xC1, 0x81, 0x40};

/* CRC16 低位字节值表*/
const u8 auchCRCLo[] = {
0x00, 0xC0, 0xC1, 0x01, 0xC3, 0x03, 0x02, 0xC2, 0xC6, 0x06,
0x07, 0xC7, 0x05, 0xC5, 0xC4, 0x04, 0xCC, 0x0C, 0x0D, 0xCD,
0x0F, 0xCF, 0xCE, 0x0E, 0x0A, 0xCA, 0xCB, 0x0B, 0xC9, 0x09,
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0x43, 0x83, 0x41, 0x81, 0x80, 0x40};
	
/* CRC8 字节值表*/
const u8 CRC8Table2[]={
0x00, 0x5E, 0xBC, 0xE2, 0x61, 0x3F, 0xDD, 0x83, 0xC2, 0x9C,
0x7E, 0x20, 0xA3, 0xFD, 0x1F, 0x41, 0x9D, 0xC3, 0x21, 0x7F,
0xFC, 0xA2, 0x40, 0x1E, 0x5F, 0x01, 0xE3, 0xBD, 0x3E, 0x60,
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0x0A, 0x54, 0xD7, 0x89, 0x6B, 0x35};

/***************************************************************************************
* 名称：Modbus_CRC()
* 功能：Modbus的CRC16校验
* 入口参数1：puchMsg 校验的数据
* 入口参数2：usDataLen 数据的长度
* 出口参数 ：CRC16结果
* --------------------------------------------------------------------------------------
* 备    注 ：小端模式,对结果进行反向以适应Modbus的要求
***************************************************************************************/
u16 Modbus_CRC(u8 *puchMsg, u32 usDataLen)
{
	u8 uchCRCHi = 0xFF ;					// 高CRC字节初始化
	u8 uchCRCLo = 0xFF ;					// 低CRC字节初始化
	u8 uIndex ;								// CRC循环中的索引 

	do
	{
		uIndex = uchCRCHi ^ *puchMsg;		// 计算CRC
		puchMsg++;
		uchCRCHi = uchCRCLo ^ auchCRCHi[uIndex] ;
		uchCRCLo = auchCRCLo[uIndex] ;
	}while(--usDataLen!=0);					// 传输消息缓冲区
	return (uchCRCLo << 8 | uchCRCHi);
}	  
			 
/***************************************************************************************
** 函数名称: ow_crc8
** 功能描述: 一线通讯模块的CRC8校验(x^8+x^5+x^4+x^0)  
** 参    数: p		/ 数据指针
** 参    数: n		/ 数据长度
** 返 回 值: CRC8结果     
***************************************************************************************/		 
u8 ow_crc8(u8 *p, u32 n)
{				 
	u8 crc8 = 0;

    for( ; n > 0; n--)
	{
        crc8 = CRC8Table2[crc8^*p];
        p++;
    }
    return(crc8);
} 								

/***************************************************************************************
* 函数名称：Chk_Sum()
* 功能描述：计算8位累积和校验值	
* 参    数：puchMsg 	/ 校验的数据
* 参    数：usDataLen	/ 数据的长度
* 返 回 值：校验结果
***************************************************************************************/
u8 Chk_Sum(u8 *puchMsg, u16 usDataLen)
{
	u8 sum;
	u32 i;

	sum = 0;
	for(i=0;i<usDataLen;i++)
	{
		sum += *puchMsg;
		puchMsg++;	
	}
	return (sum);
}

/***************************************************************************************
** 函数名称: sqrt_u16
** 功能描述: 开根号处理 
** 参    数: M		/ 32位源数据
** 返 回 值: 16位平方根
***************************************************************************************/
u16 sqrt_u16(u32 M) 
{ 
	u16 N, i; 
	u32 tmp, ttp;              // 结果、循环计数 
	if (M == 0)                // 被开方数，开方结果也为0 
	{
		return 0; 
	}

	N = 0; 

	tmp = (M >> 30);           // 获取最高位：B[m-1] 
	M <<= 2; 
	if (tmp > 1)               // 最高位为1 
	{ 
		N ++;                  // 结果当前位为1，否则为默认的0 
		tmp -= N; 
	} 

	for (i=15; i>0; i--)       // 求剩余的15位 
	{ 
		N <<= 1;               // 左移一位 

		tmp <<= 2; 
		tmp += (M >> 30);      // 假设 

		ttp = N; 
		ttp = (ttp<<1)+1; 

		M <<= 2; 
		if (tmp >= ttp)        // 假设成立 
		{ 
			tmp -= ttp; 
			N ++; 
		} 
	} 

	return N; 
} 

/***************************************************************************************
** 函数名称: sqrt_f32
** 功能描述: 浮点开方
** 参    数: num	/ 32位浮点数
** 返 回 值: 32位浮点数
***************************************************************************************/
fp32 sqrt_f32(fp32 number) 
{ 
	s32   i; 
	fp32  x, y; 
	const fp32 f = 1.5F; 
	
	x = number * 0.5F; 
	y = number; 
	i = *(s32*)&y; 
	i = 0x5f3759df - (i >> 1);  // 卡马克 
//	i = 0x5f375a86 - (i >> 1);  // Lomont 
	y = *(fp32*)&i; 
	y = y * (f - (x * y * y)); 
	y = y * (f - (x * y * y)); 
	return (number * y); 
} 		   			   

/***************************************************************************************
** 函数名称: f32toi32
** 功能描述: 32位浮点数转换为32位有符号整数
** 参    数: in	/ 32位浮点数
** 返 回 值: 32位有符号整数 
***************************************************************************************/
s32 f32toi32(fp32 in)
{
	u32 da;
	s32 out;
	u8  s;
	u8  e;

	da = cu32p(&in);					// 转换为二进制

	s   = (da >> 31);					// 符号值
	e   = (23 + 127) - (da >> 23);		// 指数值
	da  = (da & 0x7FFFFF) | 0x800000;	// 还原数据
	out = (da >>  e);					// 移出小数

	if(s)
	{
		out = -out;	
	}

	return out;
}
	   
/***************************************************************************************
** 函数名称: f32toi16
** 功能描述: 32位浮点数转换为16位有符号整数
** 参    数: in	/ 32位浮点数
** 返 回 值: 16位有符号整数 
***************************************************************************************/
s16 f32toi16(fp32 in)
{
	u32 da;
	s16 out;
	u8  s;
	u8  e;

	da = cu32p(&in);					// 转换为二进制

	s   = (da >> 31);					// 符号值
	e   = (23 + 127) - (da >> 23);		// 指数值
	da  = (da & 0x7FFFFF) | 0x800000;	// 还原数据
	out = (da >>  e) & 0x7FFF;			// 移出小数

	if(s)
	{
		out = -out;	
	}

	return out;
}	   

/***************************************************************************************
** 函数名称: E2toE10
** 功能描述: 浮点二进制转浮点十进制
** 参    数: 浮点二进制
** 返 回 值: 浮点十进制
***************************************************************************************/
u32 E2toE10(fp32 in)
{				  
	u32 da;
	s16 out[2] = {0, 0};
	u8  s;

	da = cu32p(&in);					// 转换为二进制
	out[0] = da & 0x7FFF;				// 得到尾数
	out[1] = ((s16)(da >> 23)) - 127;	// 指数值 
	s   = (da >> 31);					// 符号值

	if(s)
	{
		out[0] = -out[0];	
	}

	return cu32p(out);		
}

/***************************************************************************************
** 函数名称: E10toE2
** 功能描述: 浮点十进制转浮点二进制
** 参    数: 浮点十进制
** 返 回 值: 浮点二进制
***************************************************************************************/
fp32 E10toE2(u32 in)
{
	u16 e_in[2];  
	union
	{
		fp32 f;
		u32  i;
	}f2i;		 

	cu32p(e_in) = in;							// 分拆数据			  

	e_in[1] = ((e_in[1] + 127) & 0xFF) << 7;	// 还原指数值

	if(e_in[0] >> 15)							// 判断数据符号
	{
		e_in[0] &= 0x7FFF;						// 去除十进制符号标志
		e_in[1] |= 0x8000;						// 配置二进制符号
	}
	f2i.i = cu32p(e_in);						// 取得二进制值

	return f2i.f;
}

/***************************************************************************************
** 函数名称: BINtoBCD_16
** 功能描述: 十六位BIN转BCD
** 参    数: BIN输入
** 返 回 值: BCD输出
***************************************************************************************/
u16 BINtoBCD_16(u16 in)
{
	u16 out;

	in  %= 10000;
	out  = (in / 1000) << 12;	// 千位
	in  %= 1000;
	out |= (in / 100 ) << 8;	// 百位
	in  %= 100;
	out |= (in / 10  ) << 4;	// 十位
	out |= (in % 10  );			// 个位	

	return out;
}

/***************************************************************************************
** 函数名称: BINtoBCD_32
** 功能描述: 三十二位BIN转BCD
** 参    数: BIN输入
** 返 回 值: BCD输出
***************************************************************************************/
u32 BINtoBCD_32(u32 in)
{
	u32 out;

	in  %= 100000000;
	out  = (in / 10000000) << 28;	// 千万位
	in  %= 10000000;
	out |= (in / 1000000) << 24;	// 百万位
	in  %= 1000000;
	out |= (in / 100000) << 20;		// 十万位
	in  %= 100000;
	out |= (in / 10000) << 16;		// 万位

	in  %= 10000;
	out |= (in / 1000) << 12;		// 千位
	in  %= 1000;
	out |= (in / 100 ) << 8;		// 百位
	in  %= 100;
	out |= (in / 10  ) << 4;		// 十位
	out |= (in % 10  );				// 个位

	return out;
}
		   
/***************************************************************************************
** 函数名称: BCDtoBIN_16
** 功能描述: 十六位BCD转BIN
** 参    数: BCD输入
** 返 回 值: BIN输出
***************************************************************************************/
u16 BCDtoBIN_16(u16 in)
{
	u16 out;
	// 进行BIN转换
	out  =  (in >> 12) * 1000;			// 千位
	out += ((in >> 8 ) & 0x0F) * 100;	// 百位
	out += ((in >> 4 ) & 0x0F) * 10;	// 十位
	out += ((in      ) & 0x0F);			// 个位

	return out;
}
		   
/***************************************************************************************
** 函数名称: BCDtoBIN_32
** 功能描述: 三十二位BCD转BIN
** 参    数: BCD输入
** 返 回 值: BIN输出
***************************************************************************************/
u32 BCDtoBIN_32(u32 in)
{	 
	u32 out;	   

	out  = ((in >> 28)       ) * 10000000;	// 千万位
	out += ((in >> 24) & 0x0F) * 1000000;	// 百万位
	out += ((in >> 20) & 0x0F) * 100000;	// 十万位
	out += ((in >> 16) & 0x0F) * 10000;		// 万位
	out += ((in >> 12) & 0x0F) * 1000;		// 千位
	out += ((in >> 8 ) & 0x0F) * 100;		// 百位
	out += ((in >> 4 ) & 0x0F) * 10;		// 十位
	out += ((in      ) & 0x0F);				// 个位
	   
	return out;	
}				   

/***************************************************************************************
* 二进制转换成格雷码
* @param lStart lValue所在区间下界
* @param lEnd lValue所在区间上界
* @param lValue 要转换的二进制数的实值
* @return 返回格雷码对应的二进制数的实值
* @see g2b() g2b 格雷码转换二进制
* @see BtoG() BtoG 二进制转换格雷码
* @see GtoB() BtoG 格雷码转换二进制
* @author 黄毅
* @useage a=b2g(0,15,4); //取得4所对应格雷码的二进制值 结果a等于6
* @memo lValue的值必须在区间[lStart,lEnd]里,否则无法求得所求结果.相应地,如果区间越小,求得结
*       果所用的时间就越少.而且lStart,lEnd的值必须为2的N次方减1. 通常lStart为0.为了方便求得
*       其值,建议使用BtoG()函数来进行操作.不过这样会使计算时间加长到原来的120%~180%.
***************************************************************************************/
u32 b2g(u32 lStart, u32 lEnd, u32 lValue)
{
	u32 Start   = lStart; 
	u32 End     = lEnd; 
	u32 Temp    = 0; 
	u32 Counter = 0;
	u8  Type    = true;
	while(Start < End)
	{
		Temp = (End + Start - 1) >> 1;
		if(lValue <= Temp)
		{
			if(!Type)
			{
				Counter += ((End - Start + 1) >> 1);
			}
			End  = Temp;
			Type = true;
		}
		else
		{
			if(Type)
			{
				Counter += ((End - Start + 1) >> 1);
			}
			Start = ++Temp;
			Type  = false;
		}
	}
	return Counter;
}

/***************************************************************************************
* 格雷码转换成二进制
* @param lStart lValue对应二进制数所在区间下界
* @param lEnd lValue对应二进制数所在区间上界
* @param lValue 要转换的格雷码的实值
* @return 返回二进制数对应的格雷码的实值
* @see b2g() b2g 二进制转换格雷码
* @see BtoG() BtoG 二进制转换格雷码
* @see GtoB() BtoG 格雷码转换二进制
* @author 黄毅
* @useage a=b2g(0,15,6); //取得6所对应二进制值的格雷码 结果a等于4
* @memo lValue对应二进制数的值必须在区间[lStart,lEnd]里,否则无法求得所求结果.相应地,如果区
*       间越小,求得结果所用的时间就越少.而且lStart,lEnd的值必须为2的N次方减1. 通常lStart为0.
*       为了方便求得其值,建议使用GtoB()函数来进行操作.但会使计算时间加长到原来的105%~140%.
***************************************************************************************/
u32 g2b(u32 lStart, u32 lEnd, u32 lValue)
{
	u32 Start   = lStart;
	u32 End     = lEnd;
	u32 Counter = 0;
	u32 Temp    = 0;
	u8  Type    = true;
	while(Start < End)
	{
		Temp = Counter + ((End - Start + 1) >> 1);
		if(Type ^ (lValue < Temp))
		{ 
			if(Type) 
			{
				Counter = Temp;
			}
			Start = (Start + End + 1) >> 1;
			Type  = false;
		}
		else
		{
			if(!Type) 
			{
				Counter = Temp;
			}
			End  = (Start + End - 1) >> 1;
			Type = true;
		}
	}
	return Start;
}							   

/***************************************************************************************
//b2g外壳程序,用来算lStart,lEnd;														 
***************************************************************************************/
s32 BtoG(u32 lValue)
{
	register u32 lV = lValue,lMax = 1;
	while(lV > 0)
	{
		lV   >>= 1;
		lMax <<= 1;
	}
	if(lMax == 0)
	{
		return -1;
	}
	return b2g(0, --lMax, lValue);
}		

/***************************************************************************************
//g2b外壳程序				   
***************************************************************************************/
s32 GtoB(u32 lValue)
{
	register u32 lV = lValue, lMax = 1;
	while(lV > 0)
	{
		lV   >>= 1;
		lMax <<= 1;
	}
	if(lMax == 0) 
	{
		return -1;
	}
	return g2b(0, --lMax, lValue);
}

/***************************************************************************************
** 函数名称: Deley_1us
** 功能描述: 延时函数
** 参    数: us		/ 延时周期数
** 返 回 值: None  
***************************************************************************************/   
void Deley_1us(vu32 nCount)
{
   u16 i=0;  
   while(nCount --)
   {
      i = 5;//自己定义
      while(i --) ;    
   }
}

/***************************************************************************************
** 函数名称: calc_sum16
** 功能描述: 计算16位ChkSum,原始参数ADD_SUM为0x5a,XOR_SUM为0xa5
** 参    数: p		/ 数据指针
** 参    数: n		/ 数据长度
** 返 回 值: 返回高8位为ADD_SUM,低8位为XOR_SUM    
***************************************************************************************/
u16 calc_sum16(u8 *p,u16 n)
{
	u16 i;
	u8  j;
	u8  add_sum;
	u8  xor_sum;

	add_sum = 0x5a;				// 和的初始值
	xor_sum = 0xa5;				// 异或的初始值

	for(i = 0; i < n; i++)		// 循环运算
	{
		j = *p++;
		add_sum += j;			// 和
		xor_sum ^= j;			// 异或
	}
	return(((u16)add_sum << 8 ) | xor_sum);
} 			  

/***************************************************************************************
** 函数名称: bin_att
** 功能描述: 对*p进行2进制调度计算,
** 参    数: p		/ 数据指针
** 返 回 值: 返回调度号0-TSK_Scheduling_NUM      
***************************************************************************************/
BIN_ATT_SCALE_Typedef bin_att(vu32 *p)
{
	u32 i,j;
	
	i  = *p;
	j  = i;
	j ++;
	i  = (i ^ j) & j;
	*p = j;
	for(j = 0; j < TSK_Scheduling_NUM; j++)
	{
		if(i & 0x01)
		{
			break;
		}
		i >>= 1;
	}
	
	return((BIN_ATT_SCALE_Typedef)j);
}

/***************************************************************************************
** 函数名称: s16_ave
** 功能描述: 计算16位有符号数的平均值
** 参    数: val	/ 新值
** 参    数: p		/ 缓冲区地址
** 参    数: pe		/ 指针地址
** 参    数: n		/ 缓冲区元件个数(不是字节数)
** 返 回 值: 返回值经过4舍5入 
***************************************************************************************/
s16 s16_ave(s16 val, s16 *p, u16 *pe, u16 n)
{
	u16 i;
	s32 j = 0;

	i = *pe;										
	*(p + i) = val;
	if(++(*pe) >= n)
	{
		*pe = 0;
	}
	for(i = 0; i < n; i++)
	{
		j += *p++;
	}
	i = n >> 1;
	if(j > 0)
	{
		j += i;
	}
	else
	{
		j -= i;
	}
	j /= n;
	return (j);
}	
u16 u16_ave(u16 val,u16 *p ,u16 *pe,u16 n)
{
	u16 i;
	u32 j = 0;

	i = *pe;
	*(p + i) = val;
	if(++(*pe) >= n)
	{
		*pe = 0;
	}
	for( i = 0; i < n; i++)
	{
		j += *p++;
	}
	j += n >> 1;
	j /= n;
	return (j);
}

/***************************************************************************************
** 函数名称: s16_slide_ave
** 功能描述: 计算16位有符号数的滑动平均值,K越大滤波效果越差
** 参    数: val	/ 新值
** 参    数: p		/ 滑动平均结构体指针
** 参    数: k		/ 缓冲区元件个数(不是字节数)
** 返 回 值: 返回值经过4舍5入 
***************************************************************************************/
s16 s16_slide_ave(s16 val, pST_S16_SLIDE_AVE p ,u8 k)			// 有符号数滑动平均
{
	s32 i,j;
	
	i = val;
	j = p->val;	
	i -= j;	// 新-老 	
	i *= k;
	i <<= 8;		   	
	*((s32*)p) += i;
	return (p->val);
}	
u16 u16_slide_ave(u16 val, pST_U16_SLIDE_AVE p, u8 k)			// 无符号数滑动平均
{
	u32 i,j;
	
	i = val;			// i = 新值	
	j = p->val;		 	// j = 老值
	i -= j;				// 新 - 老	 	
	i *= k;				// 乘数量
	i <<= 8;		 	// 乘256
	*((u32*)p) += i;	// 整数据加
	return (p->val);	// 输出高字节
}
double double_slide_ave(double val, double *val_ave, u8 k)		// 浮点数滑动平均
{
	val -= *val_ave;
	val *= k;
	val /= 256;
	*val_ave += val;
	return (*val_ave);
} 

// 滑动平均滤波法
float SlidFilter(u16 *pBuf, u16 idata)
{
	u16 i=0;
	u32 filter_sum=0;
	
	pBuf[SlidFilter_NUM] = idata;
	
  for(i = 0; i < SlidFilter_NUM; i++) 
	{
    pBuf[i] = pBuf[i + 1]; // 所有数据左移,低位仍掉
    filter_sum += pBuf[i];
  }

  return (filter_sum / SlidFilter_NUM);
}

/***************************************************************************************
** 函数名称: Ask_pow_Constant
** 功能描述: 求幂函数的常量a---y=x^a(a为常数）底数为自变量幂为因变量,指数为常量的函数称为幂函数
** 参    数: 
				y :为幂函数
				x :	底数
** 返 回 值: a     
***************************************************************************************/
u8 Ask_pow_Constant(u16 y, u8 x)
{
	u8 a = 0;
	u16 y1;//中间数
	do{
		y1 = y / x;
		a += 1;	
	  }
	 while(y1 == 0);

	return(a);
}

u8 x[4]; /*定义字符数组，准备存储浮点数的四个字节*/
float a = 8692.199;
float b;

void ftoc(void)
{
	u8 		i,
				*px = x;/*px指针指向数组x*/
	void 	*pf = &a;/*void型指针指向浮点数首地址*/

	for(i = 0; i < 4; i++)
	{
		*(px + i) = *((char *)pf + i); /*强制void 型指针转成char型,因为void型指针不能运算*/	
	}
}
	
void ctof(void)
{ 
	u8 		i,
				*px = x;//px指针指向数组x
	void 	*pf = &b;
	for(i = 0; i < 4;i ++)
	{
		*((char *)pf + i) = *(px + i);
	}
}

/***************************************************************************************
** 函数名称: Complement_to_Former_Code
** 功能描述: 将负数的补码转换成原码
** 参    数: 
							x_data:输入的实体型负数
** 返 回 值: 	o_data : x_data的原码   
***************************************************************************************/
s8 Cmt_to_Frm_Code(s8 x_data)
{
	u8 i;
	s8	o_data = 0;
	for(i = 0; i < 7; i ++)
	{//将负数补码形式的二进制数值位按位取反,从最低位开始取.
		if(x_data & 0x01)
		{//当前位"1"
			o_data |= (0 << i);//对当前位取反	
		}
		else
		{
			o_data |= (1 << i);
		}
		x_data >>= 1;
	}
	o_data += 1;//最低位+1
	o_data |= 0x80;//置最高位符号位"1",即为负数
	return(o_data);
}

/***************************************************************************************
** 函数名称: GPIO_CTRL
** 功能描述: GPIO输出状态控制
参数:
sta / 0:置"0";1:置"1"
***************************************************************************************/
void GPIO_CTRL(GPIO_TypeDef* GPIOx, u16 GPIO_Pin, FlagStatus sta)
{
	if(sta==RESET)
		GPIOx->BSRRH=GPIO_Pin;//置"0"
	else if(sta==SET)
		GPIOx->BSRRL=GPIO_Pin;//置"1"
}

/***************************************************************************************
** 函数名称: Func_Idle
** 功能描述: 空闲函数,不进行任何操作.
** 参    数: None
** 返 回 值: None      
***************************************************************************************/
void Func_Idle(void)
{

};


/****************************************系统相关配置汇编**************************************************/


//THUMB指令不支持汇编内联
//采用如下方法实现执行汇编指令WFI  
__asm void WFI_SET(void)
{
	WFI;		  
}
//关闭所有中断(但是不包括fault和NMI中断)
__asm void INTX_DISABLE(void)
{
	CPSID   I
	BX      LR	  
}
//开启所有中断
__asm void INTX_ENABLE(void)
{
	CPSIE   I
	BX      LR  
}
//设置栈顶地址
//addr:栈顶地址
__asm void MSR_MSP(u32 addr) 
{
	MSR MSP, r0 			//set Main Stack value
	BX r14
}

/***************************************************************************************
**  End Of File                                                     
***************************************************************************************/
